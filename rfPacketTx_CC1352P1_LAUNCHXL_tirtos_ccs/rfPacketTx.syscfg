// These arguments were used when this file was generated. They will be automatically applied on subsequent loads 
// via the GUI or CLI invocations. Run CLI with '--help' for additional information on how to override these arguments.
// @cliArgs --board "/ti/boards/CC1352P1_LAUNCHXL" --product "simplelink_cc13x2_26x2_sdk@3.40.00.02"
// @versions {"data":"2020022712","timestamp":"2020022712","tool":"1.3.1030","templates":"2020022712"}

var RF = scripting.addModule("/ti/drivers/RF");
var CCFG = scripting.addModule("/ti/devices/CCFG");
var GPIO = scripting.addModule("/ti/drivers/GPIO");
var GPIO1 = GPIO.addInstance();
var custom = scripting.addModule("/ti/devices/radioconfig/custom");
var UART = scripting.addModule("/ti/drivers/UART", {}, false);
var UART1 = UART.addInstance();
// Use Hardware - Select the hardware to use, or 'None' to use available header pins
RF.$hardware = system.deviceData.board.components["SKY13317-373LF"];
var Power = scripting.addModule("/ti/drivers/Power", {}, false);
var Board = scripting.addModule("/ti/drivers/Board", {}, false);
var DriverLib = scripting.addModule("/ti/devices/DriverLib", {}, false);
// Enable XOSC Cap array modification - Enable modification (delta) to XOSC cap-array
CCFG.xoscCapArray = true;
// XOSC Cap Array Delta - Modify the high frequency oscillator cap-array, changing the frequency offset
CCFG.xoscCapArrayDelta = 0xC1;
// Enable Bootloader - Enable ROM Bootloader, for flashing from external host
CCFG.enableBootloader = true;
// Enable Bootloader Backdoor - When enabling the Bootloader Backdoor, the Bootloader can be activated externally by pulling a pin, even when a valid flash image is present. Note, enabling the backdoor allows an external host to read back a flash image from the device
CCFG.enableBootloaderBackdoor = true;
// Bootloader Backdoor DIO - DIO (pin) to trigger Bootloader backdoor, this pin is only needed at boot
CCFG.dioBootloaderBackdoor = 15;
// Trigger Level of Bootloader Backdoor - Active high or low on selected DIO to open boot loader backdoor
CCFG.levelBootloaderBackdoor = "Active low";
// Name
CCFG.ccfgTemplate.$name = "ti_devices_CCFGTemplate0";
// Use Hardware - Select the hardware to use, or 'None' to use available header pins
GPIO1.$hardware = system.deviceData.board.components.LED_GREEN;
// Name - The C/C++ identifier used in applications as the index parameter passed to GPIO runtime APIs
GPIO1.$name = "CONFIG_GPIO_GLED";
// Name
GPIO1.pinInstance.$name = "CONFIG_PIN_RLED";
// Proprietary (779 - 930 MHz) - Select PHY settings to be included in the generated code
custom.prop8 = ["custom868"];
var multi_stack_validate = scripting.addModule("/ti/easylink/multi_stack_validate", {}, false);
// PHY Type - Selects the PHY/setting
custom.radioConfigcustom868.phyType868 = "2gfsk50kbps";
// Fixed Packet Length - The fixed packet length will not be part of the packet data.
custom.radioConfigcustom868.fixedPacketLength = 30;
// Name
custom.radioConfigcustom868.$name = "RF_Custom_Setting";
// Name
custom.radioConfigcustom868.codeExportConfig.$name = "ti_devices_radioconfig_code_export_param0";
// PA table Export Method - Select how PA table is to be exported
custom.radioConfigcustom868.codeExportConfig.paExport = "combined";
// Use Multi-protocol patch - Use multi-protocol rather than individual protocol patches
custom.radioConfigcustom868.codeExportConfig.useMulti = true;
// Symbol Name Generation Method
custom.radioConfigcustom868.codeExportConfig.symGenMethod = "Legacy";
// Name - The C/C++ identifier used in applications as the index parameter passed to UART runtime APIs
UART1.$name = "CONFIG_UART_0";
// Use Hardware - Select the hardware to use, or 'None' to use available header pins
UART1.$hardware = system.deviceData.board.components.XDS110UART;
// Name
UART1.txPinInstance.$name = "CONFIG_PIN_0";
// Name
UART1.rxPinInstance.$name = "CONFIG_PIN_1";
// Name
UART1.uart.$name = "MyUART1";
// Suggest solution
RF.rfAntennaPin0.$suggestSolution = "43";
// Suggest solution
RF.rfAntennaPin1.$suggestSolution = "42";
// Suggest solution
RF.rfAntennaPin2.$suggestSolution = "41";
// Suggest solution
GPIO1.gpioPin.$suggestSolution = "12";
// Suggest solution
UART1.uart.$suggestSolution = "UART0";
// Suggest solution
UART1.uart.txPin.$suggestSolution = "19";
// Suggest solution
UART1.uart.rxPin.$suggestSolution = "18";
